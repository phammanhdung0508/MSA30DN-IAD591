## apps/iot/main/smart_home_mqtt/Kconfig.projbuild
```kconfig
menu "Smart Home"

config SMART_HOME_WIFI_SSID
    string "WiFi SSID"
    default ""

config SMART_HOME_WIFI_PASSWORD
    string "WiFi Password"
    default ""

config SMART_HOME_MQTT_BROKER_URI
    string "MQTT Broker URI"
    default "mqtt://localhost:1883"

config SMART_HOME_MQTT_USERNAME
    string "MQTT Username"
    default ""

config SMART_HOME_MQTT_PASSWORD
    string "MQTT Password"
    default ""

config SMART_HOME_MQTT_TOPIC_SENSOR
    string "MQTT Sensor Topic"
    default "sensor/temp_humid_msa_assign1"

config SMART_HOME_MQTT_TOPIC_CONTROL
    string "MQTT Control Topic"
    default "sensor/control_msa_assign1"

config SMART_HOME_MQTT_TOPIC_WAKE
    string "MQTT Wake Topic"
    default "sensor/wake_trigger_msa_assign1"

config SMART_HOME_MQ_ADC_CHANNEL
    int "MQ Sensor ADC1 Channel (0-9)"
    range 0 9
    default 0

config SMART_HOME_AUDIO_UDP_HOST
    string "Audio UDP Host (PC IP)"
    default "192.168.1.50"

config SMART_HOME_AUDIO_UDP_PORT
    int "Audio UDP Port"
    default 3334

endmenu
```
